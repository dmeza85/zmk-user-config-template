## config/west.yml
```yaml
manifest:
  remotes:
    - name: zmkfirmware
      url-base: https://github.com/zmkfirmware
    - name: 0xinit
      url-base: https://github.com/0xinit
    - name: Cyboard-DigitalTailor
      url-base: https://github.com/Cyboard-DigitalTailor
  projects:
    - name: zmk
      remote: zmkfirmware
      revision: main
      import: app/west.yml
    - name: zmk-keyboards
      remote: 0xinit
      revision: studio-support
      import: config/west.yml
  self:
    path: config
```
